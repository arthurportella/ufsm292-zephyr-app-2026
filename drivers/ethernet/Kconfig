## drivers/ethernet/ksz8851snl/Kconfig
```kconfig
# SPDX-License-Identifier: Apache-2.0

menuconfig ETH_KSZ8851SNL
	bool "Microchip KSZ8851SNL (Ethernet1 Xplained Pro)"
	default y
	depends on DT_HAS_MICROCHIP_KSZ8851SNL_ENABLED
	depends on NET_L2_ETHERNET
	select SPI
	select GPIO
	help
	  Driver out-of-tree para o controlador Ethernet SPI KSZ8851SNL, o chip
	  da placa ATETHERNET1-XPRO. O Zephyr não traz driver para ele.

if ETH_KSZ8851SNL

config ETH_KSZ8851SNL_RX_THREAD_STACK_SIZE
	int "Pilha da thread de recepção (bytes)"
	default 800
	help
	  A thread só fala SPI e entrega net_pkt à pilha de rede. Conferir com
	  CONFIG_THREAD_ANALYZER antes de reduzir.

config ETH_KSZ8851SNL_RX_THREAD_PRIO
	int "Prioridade (cooperativa) da thread de recepção"
	default 2

config ETH_KSZ8851SNL_TIMEOUT
	int "Espera por um net_pkt de recepção (ms)"
	default 100

config ETH_KSZ8851SNL_TX_TIMEOUT
	int "Espera por espaço na TX FIFO (ms)"
	default 100

config ETH_KSZ8851SNL_POLL_MS
	int "Releitura periódica do ISR (ms)"
	default 100
	help
	  A thread relê o ISR neste período mesmo sem borda no INTRN. O INTRN é
	  ativo por nível e o GPIO do SAM0 só entrega borda, então sem isto uma
	  interrupção que chegue durante o processamento se perderia.

endif # ETH_KSZ8851SNL
```

## dts/bindings/ethernet/microchip,ksz8851snl.yaml
```yaml
# Copyright (c) 2026 UFSM 292
# SPDX-License-Identifier: Apache-2.0

description: |
  Controlador Ethernet 10/100 Microchip KSZ8851SNL em SPI, o chip da
  ATETHERNET1-XPRO. Driver out-of-tree deste repositório.

  Exemplo:

    &sercom0 {
        eth: ksz8851snl@0 {
            compatible = "microchip,ksz8851snl";
            reg = <0>;
            spi-max-frequency = <8000000>;
            int-gpios = <&portb 4 GPIO_ACTIVE_LOW>;
            reset-gpios = <&portb 5 GPIO_ACTIVE_LOW>;
            local-mac-address = [02 00 00 00 00 0d];
        };
    };

compatible: "microchip,ksz8851snl"

include: [spi-device.yaml, ethernet-controller.yaml]

properties:
  int-gpios:
    type: phandle-array
    required: true
    description: |
      Pino INTRN do KSZ8851SNL (saída dreno aberto, ativa em nível baixo).
      Declarar como GPIO_ACTIVE_LOW.

  reset-gpios:
    type: phandle-array
    description: |
      Pino RSTN. Opcional: sem ele o driver usa só o reset por software (GRR).
```
